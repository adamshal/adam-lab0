## Part7update/Kconfig
```kconfig
mainmenu "ESE 5180 Lab 0"

choice SUM_IMPLEMENTATION
	prompt "Sum output implementation"
	default SUM_PRINT

config SUM_PRINT
	bool "Use printk for sum output"

config SUM_LOG
	bool "Use logger for sum output"
	select LOG

endchoice

source "Kconfig.zephyr"
```

## blinky_updated/Part 6/sample.yaml
```yaml
sample:
  name: ESE 5180 Lab 0
tests:
  sample.ese5180.lab0:
    tags:
      - console
      - logging
    integration_platforms:
      - nrf7002dk/nrf5340/cpuapp
```

## part8update/tests/SUM_UNIT_TEST/testcase.yaml
```yaml
tests:
  sum_log.test:
    platform_allow:
      - qemu_cortex_m3
      - nrf7002dk/nrf5340/cpuapp
    tags:
      - sum_log
      - unit
    harness: ztest
```
